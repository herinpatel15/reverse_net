## esp32/examples/basic/main/Kconfig.projbuild
```kconfig
menu "Reverse-Net Example"

    config RN_AP_SSID
        string "AP SSID"
        default "reverse-net"

    config RN_AP_PASSWORD
        string "AP password (min 8 chars)"
        default "change-me-please"

endmenu
```
